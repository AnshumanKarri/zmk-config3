#include "wheee.dtsi" // The shared dtsi file is included in the overlay

&default_transform { // Offset of 3 because the left side has 3 columns
    col-offset = <5>;
};
// Label of the kscan node in the dtsi
&kscan0 {
    col-gpios
        = <&pro_micro 19 GPIO_ACTIVE_HIGH>
        , <&pro_micro 20 GPIO_ACTIVE_HIGH>
        , <&pro_micro 21 GPIO_ACTIVE_HIGH>
        , <&pro_micro 1 GPIO_ACTIVE_HIGH>
        , <&pro_micro 0 GPIO_ACTIVE_HIGH>
        ;
};
&right_encoder {
    status = "okay";
};