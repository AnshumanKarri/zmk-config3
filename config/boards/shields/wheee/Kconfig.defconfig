## config/boards/shields/wheee/Kconfig.defconfig
```kconfig
if SHIELD_WHEEE_LEFT

# Name must be less than 16 characters long!
config ZMK_KEYBOARD_NAME
    default "wheee"

config ZMK_SPLIT_ROLE_CENTRAL
    default y

endif

if SHIELD_WHEEE_LEFT || SHIELD_WHEEE_RIGHT

config ZMK_SPLIT
    default y

endif
```

## config/boards/shields/wheee/Kconfig.shield
```kconfig
config SHIELD_WHEEE_LEFT
    def_bool $(shields_list_contains,wheee_left)

config SHIELD_WHEEE_RIGHT
    def_bool $(shields_list_contains,wheee_right)
```
